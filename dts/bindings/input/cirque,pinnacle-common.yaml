## dts/bindings/input/cirque,pinnacle-common.yaml
```yaml
properties:
  dr-gpios:
    type: phandle-array
    description: Data ready pin for the trackpad
  rotate-90:
    type: boolean
  x-invert:
    type: boolean
  y-invert:
    type: boolean
  sleep:
    type: boolean
  no-secondary-tap:
    type: boolean
  no-taps:
    type: boolean
  absolute-gestures:
    type: boolean
    description: Use absolute packets to synthesize pointer movement, circular edge scroll, taps, and drag.
  tap-to-click:
    type: boolean
    description: Emit BTN_0 click for short touches when absolute-gestures is enabled.
  double-tap-drag:
    type: boolean
    description: Toggle BTN_0 drag mode on double tap when absolute-gestures and tap-to-click are enabled.
  reverse-circular-scroll:
    type: boolean
    description: Reverse the wheel direction generated by circular edge scrolling.
  sensitivity:
    type: string
    enum:
      - 1x
      - 2x
      - 3x
      - 4x
    description: ADC attenuation (sensitivity) setting.
  x-axis-z-min:
    type: int
    default: 5
  y-axis-z-min:
    type: int
    default: 4
  touch-z-threshold:
    type: int
    default: 8
    description: Minimum absolute Z value considered an active touch.
  x-max:
    type: int
    default: 2047
    description: Maximum raw absolute X coordinate used by gesture mode.
  y-max:
    type: int
    default: 2047
    description: Maximum raw absolute Y coordinate used by gesture mode.
  edge-scroll-margin:
    type: int
    default: 220
    description: Width of the outer edge zone used for circular scrolling.
  pointer-divisor:
    type: int
    default: 4
    description: Divisor applied to absolute coordinate deltas when emitting relative pointer movement.
  tap-timeout-ms:
    type: int
    default: 180
    description: Maximum touch duration that can become a tap.
  double-tap-ms:
    type: int
    default: 350
    description: Maximum interval between taps for double-tap drag.
  tap-move-threshold:
    type: int
    default: 80
    description: Maximum raw movement during a touch that can still be considered a tap.
  scroll-step:
    type: int
    default: 160
    description: Raw edge perimeter delta per emitted wheel tick.
  inertia-enabled:
    type: boolean
    description: Continue pointer movement briefly after release in absolute gesture mode.
  inertia-decay:
    type: int
    default: 850
    description: Per-frame velocity multiplier in permille for inertial pointer movement.
  inertia-min-velocity:
    type: int
    default: 1000
    description: Minimum milli-pixel velocity before inertial pointer movement stops.
  inertia-max-ticks:
    type: int
    default: 24
    description: Maximum number of 16ms inertial pointer frames after release.
```
