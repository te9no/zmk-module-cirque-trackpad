## drivers/input/Kconfig
```kconfig
# Copyright (c) 2022 The ZMK Contributors
# SPDX-License-Identifier: MIT

menuconfig INPUT_PINNACLE_DYA
    bool "Cirque Pinnacle trackpads"
    default y
    depends on INPUT
    depends on DT_HAS_CIRQUE_PINNACLE_DYA_ENABLED
    select GPIO
    select I2C if $(dt_compat_on_bus,$(DT_COMPAT_CIRQUE_PINNACLE_DYA),i2c)
    select SPI if $(dt_compat_on_bus,$(DT_COMPAT_CIRQUE_PINNACLE_DYA),spi)
    help
      Enable driver for Cirque Pinnacle trackpads

config INPUT_PINNACLE_STUDIO_RPC
    bool "Enable DYA trackpad custom Studio RPC"
    default y if ZMK_STUDIO_RPC
    select NANOPB
    select ZMK_SPLIT_RELAY_EVENT if ZMK_SPLIT
    help
      Enable the custom Studio RPC subsystem for the Cirque trackpad Web UI.
      This can be enabled on a central half even when the physical trackpad is
      on a peripheral half; in that case the subsystem is published, but only
      locally registered Cirque devices can be listed or controlled.

config INPUT_PINNACLE_STUDIO_RPC_SPLIT_TIMEOUT_MS
    int "DYA trackpad Studio RPC split request timeout"
    default 5000
    depends on INPUT_PINNACLE_STUDIO_RPC && ZMK_SPLIT_RELAY_EVENT

if INPUT_PINNACLE_DYA

config INPUT_PINNACLE_INIT_PRIORITY
    int "Cirque Pinnacle initialization priority"
    default INPUT_INIT_PRIORITY

config INPUT_PINNACLE_I2C_RETRIES
    int "Cirque Pinnacle I2C retry count"
    depends on I2C
    range 0 10
    default 3
    help
      Number of additional attempts for low-level I2C register reads and writes.
      This helps software I2C routes tolerate transient NACKs during deferred
      module initialization.

config INPUT_PINNACLE_I2C_RETRY_DELAY_MS
    int "Cirque Pinnacle I2C retry delay"
    depends on I2C
    range 0 100
    default 2
    help
      Delay in milliseconds between low-level I2C retry attempts.

if ZMK_MOUSE

config ZMK_INPUT_PINNACLE_IDLE_SLEEPER
    bool "Pinnacle Sleep linked to ZMK idle state"
    default n

endif

endif
```

## dts/bindings/input/cirque,pinnacle-spi.yaml
```yaml
description: |
  Sensor driver for the Cirque Pinnacle trackpad ASICs, using the SPI interface

compatible: "cirque,pinnacle-dya"

include: ["spi-device.yaml", "cirque,pinnacle-common.yaml"]
```
